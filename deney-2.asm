
	LIST P=16F877A
	#INCLUDE <P16F877A.INC>
	__CONFIG H'3F31'
	SAYICI EQU 0X20
	SAYICI_YEDEK EQU 0X21
	TMR1H_YEDEK EQU 0X22
	TMR1L_YEDEK EQU 0X23
 	ORG 0X000
	GOTO ANA_METOT
	ORG 0X004

KESME_METOT
	BTFSS PIR1,TMR1IF
	RETFIE
	BCF PIR1,TMR1IF

	MOVF TMR1H_YEDEK,W
	MOVWF TMR1H
	MOVF TMR1L_YEDEK,W
	MOVWF TMR1L

	DECFSZ SAYICI,F
	RETFIE

	INCF PORTB,F

	MOVLW D'20'
	MOVWF SAYICI
	MOVWF SAYICI_YEDEK

	RETFIE

ANA_METOT
	BANKSEL TRISA
	MOVLW 0X06
	MOVWF ADCON1
	MOVLW B'00000011'
	MOVWF TRISA
	CLRF TRISB
	BANKSEL PORTA
	MOVLW B'00000011'
	MOVWF PORTA
	CLRF PORTB

	BANKSEL INTCON
	MOVLW B'11000000'
	MOVWF INTCON
	BANKSEL INTCON

	BANKSEL PIE1
	BSF PIE1,TMR1IE
	BANKSEL PIE1

	BANKSEL PIR1
	BCF PIR1,TMR1IF
	BANKSEL PIR1

	BANKSEL T1CON
	MOVLW B'00010001'
	MOVWF T1CON
	BANKSEL T1CON

	BANKSEL TMR1H
	MOVLW 0X9E
	MOVWF TMR1H_YEDEK
	MOVWF TMR1H
	MOVLW 0X58
	MOVWF TMR1L_YEDEK
	MOVWF TMR1L
	CLRF SAYICI
	MOVLW D'20'
	MOVWF SAYICI_YEDEK
	MOVWF SAYICI
	BANKSEL TMR1H

KONTROL
	BTFSC PORTA,0
	GOTO DEGER_ARTIR
	BTFSC PORTA,1
	GOTO DEGER_AZALT
	GOTO KONTROL

UST_SINIR
	MOVLW D'15'
	MOVWF SAYICI_YEDEK
	MOVLW 0X84
	MOVWF TMR1L_YEDEK
	MOVLW 0X6D
	MOVWF TMR1H_YEDEK
	RETURN

ALT_SINIR
	MOVLW D'6'
	MOVWF SAYICI_YEDEK
	MOVLW 0X2C
	MOVWF TMR1L_YEDEK
	MOVLW 0XCF
	MOVWF TMR1H_YEDEK
	RETURN

DEGER_ARTIR
	INCF SAYICI_YEDEK,F
	MOVF TMR1L_YEDEK,W 
	SUBLW 0XC4
	MOVWF TMR1L_YEDEK 
	MOVF TMR1H_YEDEK,W 
	SUBLW 0X09
	MOVWF TMR1H_YEDEK
	MOVLW D'15'
	SUBWF SAYICI_YEDEK,W
	BTFSS STATUS,Z
	GOTO KONTROL
	CALL UST_SINIR

DEGER_AZALT
	DECF SAYICI_YEDEK,F
	MOVF TMR1L_YEDEK,W
	ADDLW 0XC4
	MOVWF TMR1L_YEDEK
	MOVF TMR1H_YEDEK,W
	ADDLW 0X09
	MOVWF TMR1H_YEDEK
	MOVLW D'5'
	SUBWF SAYICI_YEDEK,W
	BTFSS STATUS,Z
	GOTO KONTROL
	CALL ALT_SINIR

KONTROL_METOT
	GOTO KONTROL_METOT

END